## board/friendlyarm/mini210s/Kconfig
```kconfig
if TARGET_MINI210S

config SYS_BOARD
	default "mini210s"

config SYS_VENDOR
	default "friendlyarm"

config SYS_SOC
	default "s5pc1xx"

config SYS_CONFIG_NAME
	default "mini210s"

source "board/friendlyarm/Kconfig"

endif
```

## configs/friendlyarm_mini210s_defconfig
```kconfig
CONFIG_ARM=y
CONFIG_ARCH_S5PC1XX=y
CONFIG_TARGET_MINI210S=y
CONFIG_SPL_SIZE_LIMIT=0x4000
CONFIG_SPL=y
CONFIG_SPL_GPIO=y
CONFIG_SPL_LIBCOMMON_SUPPORT=y
CONFIG_SPL_LIBGENERIC_SUPPORT=y
CONFIG_SPL_SERIAL=y
CONFIG_DEFAULT_DEVICE_TREE="friendlyarm_mini210s"
CONFIG_SPL_BOARD_INIT=y
CONFIG_ARCH_CPU_INIT=y
CONFIG_SPL_TEXT_BASE=0xd0020010
CONFIG_SYS_TEXT_BASE=0x20000000
CONFIG_SYS_LOAD_ADDR=0x20000000
CONFIG_STACK_SIZE=0x1000000
CONFIG_NAND_BOOT=y
CONFIG_NR_DRAM_BANKS=1
CONFIG_SD_BOOT=y
CONFIG_DEBUG_UART=y
CONFIG_DEBUG_UART_BASE=0xe2900000
CONFIG_DEBUG_UART_CLOCK=66355200
CONFIG_DEBUG_UART_SHIFT=0
CONFIG_DEBUG_UART_BOARD_INIT=y
CONFIG_S5P_SERIAL=y
CONFIG_BOARD_EARLY_INIT_R=y
CONFIG_NAND_S5PC110=y
# CONFIG_SERIAL_PRESENT is not set
CONFIG_NET_RANDOM_ETHADDR=y
CONFIG_CMD_LINK_LOCAL=y
CONFIG_MTD=y
CONFIG_CMD_NAND=y
CONFIG_CMD_PING=y
CONFIG_FIT=y
CONFIG_LZMA=y
CONFIG_MMC_SDHCI=y
CONFIG_MMC_SDHCI_S5P=y
CONFIG_CMD_MMC=y
# BR2_TARGET_ROOTFS_TAR is not set
CONFIG_FS_EXT4=y
CONFIG_FS_FAT=y
CONFIG_DOS_PARTITION=y
CONFIG_EFI_PARTITION=y
CONFIG_PARTITION_UUIDS=y
CONFIG_PARTITION_TYPE_GUID=y
CONFIG_CMD_FAT=y
CONFIG_CMD_EXT2=y
CONFIG_CMD_EXT4=y
CONFIG_CMD_FS_GENERIC=y
CONFIG_MMC_IO_VOLTAGE=y
CONFIG_MMC_HS400_ES_SUPPORT=y
CONFIG_MMC_HS400_SUPPORT=y
# CONFIG_MMC_SDHCI_ADMA is not set
CONFIG_MMC_QUIRKS=y
CONFIG_CMD_BOOTMENU=y
CONFIG_AUTOBOOT_MENU_SHOW=y
```
